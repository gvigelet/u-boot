## board/d3/tda2eco/Kconfig
```kconfig
if TARGET_D3_TDA2ECO

config SYS_BOARD
	default "tda2eco"

config SYS_VENDOR
	default "d3"

config SYS_CONFIG_NAME
	default "d3_tda2eco"

endif
```

## configs/d3_tda2eco_defconfig
```kconfig
CONFIG_ARM=y
CONFIG_OMAP54XX=y
CONFIG_TARGET_D3_TDA2ECO=y
CONFIG_SPL=y
CONFIG_SYS_EXTRA_OPTIONS="CONS_INDEX=3"
# CONFIG_CMD_IMLS is not set
# CONFIG_CMD_FLASH is not set
# CONFIG_CMD_SETEXPR is not set
```
